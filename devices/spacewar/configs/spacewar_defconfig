## devices/spacewar/u-boot/files/configs/hakios_spacewar_storage_defconfig
```kconfig
#include "hakios_spacewar_defconfig"
CONFIG_ENV_DEFAULT_ENV_TEXT_FILE="board/qualcomm/hakios-spacewar-storage.env"
```

## devices/spacewar/u-boot/files/configs/hakios_spacewar_usbdiag_defconfig
```kconfig
#include "hakios_spacewar_defconfig"
CONFIG_DEFAULT_DEVICE_TREE="qcom/sm7325-nothing-spacewar-usbdiag"
CONFIG_ENV_DEFAULT_ENV_TEXT_FILE="board/qualcomm/hakios-spacewar-usbdiag.env"
```
